## conf/machine/imx6ul-caisteal.conf
```bitbake
#@TYPE: Machine
#@NAME: Caisteal MKV Secure Storage
#@SOC: i.MX6UL
#@DESCRIPTION: Machine configuration for Caisteal i.MX6UL MKV
#@MAINTAINER: Harkirat S Virk <harkiratsvirk@gmail.com>

MACHINEOVERRIDES =. "mx6:mx6ull:"

include conf/machine/include/imx-base.inc
include conf/machine/include/tune-cortexa7.inc

PREFERRED_PROVIDER_u-boot ??= "u-boot-caisteal"
PREFERRED_PROVIDER_virtual/kernel ??= "linux-caisteal"
PREFERRED_PROVIDER_virtual/bootloader= "u-boot-caisteal"
PREFERRED_VERSION_linux-caisteal ??= "5.15%"
PREFERRED_VERSION_u-boot-caisteal ??= "2021.10%"

KERNEL_DEVICETREE = "imx6ul-caisteal.dtb"

UBOOT_CONFIG ??= "qspi"
UBOOT_CONFIG[qspi] = "mx6ul_caisteal_config,ubifs"
UBOOT_CONFIG[mfgtool] = "mx6ul_caisteal_config"

SERIAL_CONSOLES = "115200;ttymxc0"

IMAGE_FSTYPES = "${INITRAMFS_FSTYPES}"
IMAGE_FSTYPES += "ext3"

MKUBIFS_ARGS = "--min-io-size 1 --leb-size 262016 --max-leb-cnt 1024"
UBINIZE_ARGS = "--min-io-size 1 --peb-size 262144 --sub-page-size 1"
```
